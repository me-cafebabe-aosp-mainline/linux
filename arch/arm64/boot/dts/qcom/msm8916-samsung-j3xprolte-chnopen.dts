// SPDX-License-Identifier: GPL-2.0-only

/dts-v1/;

#include "msm8916-samsung-j3xprolte-common.dtsi"

#include <dt-bindings/arm/qcom,ids.h>

/ {
	model = "Samsung Galaxy J3 Pro (SM-J3110)";
	compatible = "samsung,j3xprolte-chnopen", "qcom,msm8916";
	chassis-type = "handset";

	qcom,msm-id = <QCOM_ID_MSM8916 0>;
	qcom,board-id = <0xce08ff01 3>;
};

&usb_hs_phy {
	qcom,init-seq = /bits/ 8 <0x1 0x5f 0x2 0x27>;
};
